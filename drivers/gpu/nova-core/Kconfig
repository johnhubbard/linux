## drivers/gpu/nova-core/Kconfig
```kconfig
config NOVA_CORE
	tristate "Nova Core GPU driver"
	depends on 64BIT
	depends on PCI
	depends on RUST
	depends on !CPU_BIG_ENDIAN
	select AUXILIARY_BUS
	select RUST_FW_LOADER_ABSTRACTIONS
	default n
	help
	  Choose this if you want to build the Nova Core driver for Nvidia
	  GPUs based on the GPU System Processor (GSP). This is true for Turing
	  and later GPUs.

	  This driver is work in progress and may not be functional.

	  If M is selected, the module will be called nova-core.

config NOVA_CORE_IRQ_SELFTEST
	bool "Nova Core interrupt delivery self-test"
	depends on NOVA_CORE
	help
	  Run an interrupt delivery self-test during nova-core probe. It
	  injects a known vector through the GPU interrupt controller's
	  software trigger and confirms the interrupt reaches the driver's
	  handler, validating the PCI interrupt path from the GPU to the CPU
	  with no dependency on GSP firmware. The result is printed to dmesg.

	  If the test fails, the PCI probe fails and the driver does not load.

	  This is intended for driver bring-up and for debugging PCI, MSI, or
	  passthrough setups. If unsure, say N.
```
